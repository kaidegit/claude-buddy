## app/boards/hs-buddy/Kconfig.board
```kconfig
rsource "../hs-buddy_base/Kconfig.board"

if BSP_USING_LCD && !BSP_USING_BUILTIN_LCD

choice CUSTOM_LCD_MODULE
    prompt "Custom LCD driver"
    default LCD_USING_ST7365_8080_480X272

config LCD_USING_ST7365_8080_480X272
    bool "ST7365_8080_480X272"
    select LCD_USING_ST7365
    select BSP_LCDC_USING_DBI
    select LCD_USING_PWM_AS_BACKLIGHT

endchoice

config LCD_USING_ST7365
    bool
    default n

config LCD_HOR_RES_MAX
    int
    default 480 if LCD_USING_ST7365_8080_480X272

config LCD_VER_RES_MAX
    int
    default 272 if LCD_USING_ST7365_8080_480X272

config LCD_DPI
    int
    default 315 if LCD_USING_ST7365_8080_480X272

endif
```

## app/boards/hs-buddy/hcpu/Kconfig.board
```kconfig
config BSP_USING_BOARD_HS_BUDDY
    bool
    select SOC_SF32LB52X
    select BF0_HCPU
    default y

rsource "../Kconfig.board"
```

## app/project/Kconfig.proj
```kconfig
# Application-specific configuration.
config CUSTOM_MEM_MAP
    bool
    select custom_mem_map
    default y if !SOC_SIMULATOR

config IMAGE_CACHE_IN_PSRAM_SIZE
    int "LVGL image cache size in PSRAM"
    depends on BSP_USING_PSRAM
    default 1048576

config IMAGE_CACHE_IN_PSRAM_SIZE
    int
    depends on !BSP_USING_PSRAM
    default 0

config IMAGE_CACHE_IN_SRAM_SIZE
    int "LVGL image cache size in SRAM"
    default 0

choice BUDDY_UI_FRONTEND
    prompt "Buddy UI frontend"
    default BUDDY_UI_FRONTEND_390X450
    help
        Select the LVGL frontend at build time. Backend data access stays behind
        the explicit buddy_ui_data API so each board can use a fixed UI layout
        without changing protocol or storage behavior.

config BUDDY_UI_FRONTEND_390X450
    bool "390x450 fixed layout"
    help
        Current Huangshan Pi LVGL frontend for the 390x450 display. Keep this as
        the default to avoid changing the existing screen behavior.

endchoice
```

## tests/hardware/project/Kconfig
```kconfig
# Kconfig root for the hardware test firmware.
source "$SIFLI_SDK/Kconfig.v2"
rsource "Kconfig.proj"
```
